## board/esp32s3-box-3/Kconfig
```kconfig
#
# ESP32-S3-BOX-3 custom board configuration
#

if ARCH_BOARD_CUSTOM

config ESP32S3_BOX_LCD
	bool "Enable ESP32-S3-BOX-3 LCD"
	default n
	select ESP32S3_SPI2
	select SPI
	select SPI_CMDDATA
	select LCD
	select LCD_DEV
	select LCD_ILI9341
	---help---
		Enable the ESP32-S3-BOX-3 ILI9342C-compatible LCD.

config ESP32S3_BOARD_TOUCHSCREEN
	bool "Enable ESP32-S3-BOX-3 touchscreen"
	default n
	select ESP32S3_I2C0
	select INPUT
	select INPUT_TOUCHSCREEN
	---help---
		Enable the ESP32-S3-BOX-3 GT911 touchscreen.

menu "Board Touchscreen Configuration"
	depends on ESP32S3_BOARD_TOUCHSCREEN

config ESP32S3_BOARD_TOUCHSCREEN_PATH
	string "Touchscreen path"
	default "/dev/input0"

config ESP32S3_BOARD_TOUCHSCREEN_SAMPLE_CACHES
	int "Touchscreen sample cache count"
	default 64

config ESP32S3_BOARD_TOUCHSCREEN_SAMPLE_DELAYS
	int "Touchscreen sample delay ticks"
	default 20

endmenu

config ESP32S3_BOX_AUDIO
	bool "Enable ES7210 microphone capture"
	default n
	select ESP32S3_I2C0
	select ESP32S3_I2S
	select ESP32S3_I2S0
	select ESP32S3_I2S0_RX
	select ESP32S3_I2S0_MCLK
	select AUDIO
	select AUDIO_I2S
	select DRIVERS_AUDIO
	---help---
		Initialize the ES7210 microphone ADC and register I2S0 RX as
		/dev/audio/pcm_in0.

endif # ARCH_BOARD_CUSTOM
```

## board/esp32s3-devkit/Kconfig
```kconfig
#
# For a description of the syntax of this configuration file,
# see the file kconfig-language.txt in the NuttX tools repository.
#

if ARCH_BOARD_CUSTOM

choice
	prompt "ESP32-S3-DevKitC-1 version"
	default CCF_ESP32S3_DEVKITC_1_V10

config CCF_ESP32S3_DEVKITC_1_V10
	bool "ESP32-S3-DevKitC-1 v1.0"

config CCF_ESP32S3_DEVKITC_1_V11
	bool "ESP32-S3-DevKitC-1 v1.1"
endchoice

config ESP32S3_DEVKIT_INMP441
	bool "Enable INMP441 I2S microphone"
	default n
	select ESP32S3_I2S
	select ESP32S3_I2S1
	select ESP32S3_I2S1_RX
	select AUDIO
	select AUDIO_I2S
	select AUDIO_I2SCHAR
	select DRIVERS_AUDIO
	---help---
		Register ESP32-S3 I2S1 RX as an audio capture device for an
		external INMP441 digital microphone. This board option only wires
		the I2S audio path; INMP441 has no I2C codec initialization.

config ESP32S3_DEVKIT_OLED
	bool "Enable 0.96 inch SSD1306 I2C OLED"
	default n
	select ESP32S3_I2C
	select ESP32S3_I2C0
	select LCD
	select LCD_DEV
	---help---
		Register a 0.96 inch 128x64 SSD1306-compatible OLED on I2C0.
		The audio_event board configuration uses GPIO4 as SDA, GPIO5 as
		SCL, and the typical 7-bit I2C address 0x3c.

endif # ARCH_BOARD_CUSTOM
```

## board/esp32s3-devkit/configs/audio_event_espnn_verify/defconfig
```kconfig
#
# audio_event end-to-end ESP-NN verification profile for the 4-class model.
#
# CONFIG_ESP32S3_I2S1_TX is not set
# CONFIG_NSH_ARGCAT is not set
# CONFIG_NSH_CMDOPT_HEXDUMP is not set
CONFIG_ARCH="xtensa"
CONFIG_ARCH_BOARD_COMMON=y
CONFIG_ARCH_BOARD_CUSTOM=y
CONFIG_ARCH_BOARD_CUSTOM_DIR="../vendor/espressif/boards/esp32s3/esp32s3-devkit"
CONFIG_ARCH_BOARD_CUSTOM_DIR_RELPATH=y
CONFIG_ARCH_BOARD_CUSTOM_NAME="esp32s3-devkit"
CONFIG_ARCH_CHIP="esp32s3"
CONFIG_ARCH_CHIP_ESP32S3=y
CONFIG_ARCH_CHIP_ESP32S3WROOM1N16R8=y
CONFIG_ARCH_INTERRUPTSTACK=2048
CONFIG_ARCH_STACKDUMP=y
CONFIG_ARCH_XTENSA=y
CONFIG_AUDIO_BUFFER_NUMBYTES=2048
CONFIG_AUDIO_NUM_BUFFERS=4
CONFIG_BOARD_LOOPSPERMSEC=16717
CONFIG_BUILTIN=y
CONFIG_CXX_STANDARD="gnu++17"
CONFIG_DEBUG_FULLOPT=y
CONFIG_DEBUG_SYMBOLS=y
CONFIG_ESP32S3_DEFAULT_CPU_FREQ_240=y
CONFIG_ESP32S3_DEVKIT_INMP441=y
CONFIG_ESP32S3_DEVKIT_OLED=y
CONFIG_ESP32S3_I2C0_SCLPIN=5
CONFIG_ESP32S3_I2C0_SDAPIN=4
CONFIG_ESP32S3_I2S1_BCLKPIN=18
CONFIG_ESP32S3_I2S1_DATA_BIT_WIDTH_32BIT=y
CONFIG_ESP32S3_I2S1_DINPIN=15
CONFIG_ESP32S3_I2S1_SAMPLE_RATE=16000
CONFIG_ESP32S3_I2S1_WSPIN=17
CONFIG_ESP32S3_SPIFLASH=y
CONFIG_ESP32S3_SPIFLASH_LITTLEFS=y
CONFIG_ESP32S3_SPIFLASH_LITTLEFS_MOUNTPT="/data"
CONFIG_ESP32S3_STORAGE_MTD_OFFSET=0x180000
CONFIG_ESP32S3_STORAGE_MTD_SIZE=0x800000
CONFIG_ESP32S3_SPIRAM=y
CONFIG_ESP32S3_SPIRAM_MODE_OCT=y
CONFIG_ESP32S3_SPIRAM_SPEED_80M=y
CONFIG_ESP32S3_UART0=y
CONFIG_EXAMPLES_AUDIO_EVENT=y
CONFIG_EXAMPLES_AUDIO_EVENT_ARENA_SIZE=65536
CONFIG_EXAMPLES_AUDIO_EVENT_DEVPATH="/dev/audio/pcm_in1"
CONFIG_EXAMPLES_AUDIO_EVENT_INMP441_32BIT=y
CONFIG_EXAMPLES_AUDIO_EVENT_KNOCK_THRESHOLD=380
CONFIG_EXAMPLES_AUDIO_EVENT_OLED_UI=y
CONFIG_EXAMPLES_AUDIO_EVENT_POWER_ENERGY_GATE=y
CONFIG_EXAMPLES_AUDIO_RECORD=y
CONFIG_EXAMPLES_AUDIO_TEST=y
CONFIG_EXAMPLES_AUDIO_TEST_CHANNELS=2
CONFIG_FS_PROCFS=y
CONFIG_HAVE_CXX=y
CONFIG_I2C_DRIVER=y
CONFIG_I2S_DMADESC_NUM=4
CONFIG_IDLETHREAD_STACKSIZE=3072
CONFIG_INIT_ENTRYPOINT="nsh_main"
CONFIG_INIT_STACKSIZE=3072
CONFIG_INTELHEX_BINARY=y
CONFIG_LCD_MAXCONTRAST=255
CONFIG_LCD_SSD1306_I2C=y
CONFIG_LCD_UG2864HSWEG01=y
CONFIG_LIBCXX=y
CONFIG_LINE_MAX=64
CONFIG_MATH_GEMMLOWP=y
CONFIG_MATH_KISSFFT=y
CONFIG_MATH_RUY=y
CONFIG_MM_REGIONS=2
CONFIG_NSH_ARCHINIT=y
CONFIG_NSH_BUILTIN_APPS=y
CONFIG_NSH_FILEIOSIZE=512
CONFIG_NSH_READLINE=y
CONFIG_PREALLOC_TIMERS=4
CONFIG_RAM_SIZE=114688
CONFIG_RAM_START=0x20000000
CONFIG_RR_INTERVAL=200
CONFIG_SCHED_WAITPID=y
CONFIG_START_DAY=6
CONFIG_START_MONTH=12
CONFIG_START_YEAR=2011
CONFIG_SYSLOG_BUFFER=y
CONFIG_SYSTEM_FLATBUFFERS=y
CONFIG_SYSTEM_NSH=y
CONFIG_TFLITEMICRO=y
CONFIG_TFLITEMICRO_ESP_NN=y
CONFIG_TFLITEMICRO_ESP_NN_CONV2D_GENERAL=y
CONFIG_TFLITEMICRO_ESP_NN_CONV2D_OUTPUT_TENSOR_MASK=0x0a800000
CONFIG_TFLITEMICRO_ESP_NN_CONV2D_VERIFY=y
CONFIG_TFLITEMICRO_ESP_NN_DEPTHWISE_CONV2D_OUTPUT_TENSOR_MASK=0x05000000
CONFIG_TFLITEMICRO_ESP_NN_DEPTHWISE_CONV2D_VERIFY=y
CONFIG_TFLITEMICRO_ESP_NN_TRACE=y
CONFIG_TLS_NELEM=4
CONFIG_TLS_TASK_NELEM=4
CONFIG_UART0_SERIAL_CONSOLE=y
CONFIG_XTENSA_CP_INITSET=0x0009
CONFIG_XTENSA_TOOLCHAIN_ESP=y
```
