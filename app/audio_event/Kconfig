## app/audio_event/Kconfig
```kconfig
#
# For a description of the syntax of this configuration file,
# see the file kconfig-language.txt in the NuttX tools repository.
#

config EXAMPLES_AUDIO_EVENT
	tristate "Audio event detection demo"
	default n
	depends on TFLITEMICRO && AUDIO && MATH_KISSFFT
	---help---
		Local audio event detection system:
		capture -> log-mel feature extraction -> TFLite inference -> alert.
		Supports knock and cough detection with background and silence
		rejection classes.

if EXAMPLES_AUDIO_EVENT

choice EXAMPLES_AUDIO_EVENT_MODEL
	prompt "Audio event model"
	default EXAMPLES_AUDIO_EVENT_MODEL_4CLASS
	---help---
		Select the deployed classification model. The choice changes the
		model data, the class count, the class names and the event/keyword
		class split in one step.

config EXAMPLES_AUDIO_EVENT_MODEL_4CLASS
	bool "4-class small DS-CNN (knock/cough/background/silence)"
	---help---
		Default model: INT8 small DS-CNN, ~12 KB, 40 ms inference.
		Classes: knock, cough, background, silence (2 event classes).

config EXAMPLES_AUDIO_EVENT_MODEL_8CLASS
	bool "8-class S3-large (3 events + 3 keywords + 2 background)"
	---help---
		INT8 S3-large DS-CNN, ~37 KB, ~48 ms inference with ESP-NN.
		Classes: knock, cough, glass_breaking, yes, no, stop, background,
		silence (3 event classes + 3 keyword classes).

endchoice

config EXAMPLES_AUDIO_EVENT_PROGNAME
	string "Program name"
	default "audio_event"
	---help---
		This is the name of the program that will be used when the NSH ELF
		program is installed.

config EXAMPLES_AUDIO_EVENT_PRIORITY
	int "Audio event demo task priority"
	default 100

config EXAMPLES_AUDIO_EVENT_STACKSIZE
	int "Audio event demo stack size"
	default 16384

config EXAMPLES_AUDIO_EVENT_DEVPATH
	string "Audio capture device path"
	default "/dev/audio/pcm0c"

config EXAMPLES_AUDIO_EVENT_INMP441_32BIT
	bool "Convert INMP441 32-bit I2S capture to mono PCM16"
	default n
	---help---
		Enable this when the capture device receives an INMP441 style
		32-bit I2S stream. The application configures the audio device
		as 16 kHz, two-channel, 32-bit PCM, selects one I2S slot, then
		converts it to the 16 kHz mono int16 samples expected by the
		model frontend.

config EXAMPLES_AUDIO_EVENT_INMP441_SLOT
	int "INMP441 slot index"
	default 0
	range 0 1
	depends on EXAMPLES_AUDIO_EVENT_INMP441_32BIT
	---help---
		Select the 32-bit I2S slot that contains microphone data.
		Use 0 for the left slot and 1 for the right slot.

config EXAMPLES_AUDIO_EVENT_INMP441_SHIFT
	int "INMP441 int32 to int16 right shift"
	default 16
	range 0 24
	depends on EXAMPLES_AUDIO_EVENT_INMP441_32BIT
	---help---
		Arithmetic right shift applied before saturating to int16.
		INMP441 commonly places 24-bit samples in the high bits of a
		32-bit slot, so 16 is a conservative starting point. Reduce
		this value only if the converted PCM16 level is too low.

config EXAMPLES_AUDIO_EVENT_ARENA_SIZE
	int "TFLite Micro tensor arena size"
	default 196608 if EXAMPLES_AUDIO_EVENT_MODEL_8CLASS
	default 65536
	range 32768 262144

config EXAMPLES_AUDIO_EVENT_HOP_MS
	int "Inference window hop in milliseconds"
	default 250
	range 20 1000

config EXAMPLES_AUDIO_EVENT_REMOTE_REPORT
	bool "Enable asynchronous HTTP remote alert reporting"
	default n
	depends on NET_TCP
	select NETUTILS_WEBCLIENT
	---help---
		Send locally confirmed events to an HTTP receiver from a dedicated
		low-priority worker. Local serial/OLED alerting never depends on
		network availability. Wi-Fi association, DHCP and DNS must be
		configured separately for the target board.

if EXAMPLES_AUDIO_EVENT_REMOTE_REPORT

config EXAMPLES_AUDIO_EVENT_REMOTE_DEVICE_ID
	string "Anonymous remote-report device ID"
	default "esp32s3-audio-01"
	---help---
		A non-personal identifier included in every event payload. Only
		letters, digits, underscore, hyphen and dot are retained on wire.

config EXAMPLES_AUDIO_EVENT_REMOTE_HTTP_ENDPOINT
	string "HTTP event endpoint"
	default ""
	---help---
		HTTP URL for POST requests, for example:
		http://192.168.1.10:8080/api/v1/audio-events
		Leave empty until a trusted LAN receiver is configured.

config EXAMPLES_AUDIO_EVENT_REMOTE_HTTP_TOKEN
	string "HTTP bearer token (optional)"
	default ""
	---help---
		Optional Authorization bearer token. Do not commit a real token in
		defconfig or source control, and do not enable it for an untrusted
		public network without TLS and certificate verification.

config EXAMPLES_AUDIO_EVENT_REMOTE_QUEUE_DEPTH
	int "Remote report RAM queue depth"
	default 8
	range 1 32

config EXAMPLES_AUDIO_EVENT_REMOTE_HTTP_TIMEOUT_MS
	int "HTTP inactivity timeout (ms)"
	default 5000
	range 1000 60000

config EXAMPLES_AUDIO_EVENT_REMOTE_RETRY_MAX
	int "Maximum retries after the first send attempt"
	default 3
	range 0 10

config EXAMPLES_AUDIO_EVENT_REMOTE_RETRY_INITIAL_MS
	int "Initial retry backoff (ms)"
	default 1000
	range 100 30000

config EXAMPLES_AUDIO_EVENT_REMOTE_RETRY_MAX_DELAY_MS
	int "Maximum retry backoff (ms)"
	default 30000
	range 1000 60000

config EXAMPLES_AUDIO_EVENT_REMOTE_THREAD_STACKSIZE
	int "Remote reporter thread stack size"
	default 6144
	range 2048 16384

config EXAMPLES_AUDIO_EVENT_REMOTE_THREAD_PRIORITY
	int "Remote reporter thread priority"
	default 80
	range 1 255
	---help---
		Keep this below the audio application and capture-worker priorities
		so reporting cannot delay PCM processing.

endif # EXAMPLES_AUDIO_EVENT_REMOTE_REPORT

choice EXAMPLES_AUDIO_EVENT_POWER_MODE

	prompt "Audio processing power mode"
	default EXAMPLES_AUDIO_EVENT_POWER_CONTINUOUS
	---help---
		Continuous keeps the existing feature extraction and model inference
		on every inference window. Energy gate keeps I2S capture running but
		skips DSP/TFLM on quiet windows after startup calibration.

config EXAMPLES_AUDIO_EVENT_POWER_CONTINUOUS
	bool "Continuous inference (P0 baseline)"

config EXAMPLES_AUDIO_EVENT_POWER_ENERGY_GATE
	bool "PCM energy gate (P1)"

endchoice

if EXAMPLES_AUDIO_EVENT_POWER_ENERGY_GATE

config EXAMPLES_AUDIO_EVENT_POWER_GATE_DEFAULT
	bool "Enable PCM energy gate by default"
	default n
	---help---
		Keep the gate implementation available, but start in continuous P0
		mode unless --power-gate is passed to audio_event. This makes the
		default behavior deterministic for functional and power baselines;
		--no-power-gate remains available as an explicit P0 marker.

config EXAMPLES_AUDIO_EVENT_ENERGY_GATE_CALIBRATION_MS
	int "Startup noise-floor calibration time (ms)"
	default 2000
	range 500 10000

config EXAMPLES_AUDIO_EVENT_ENERGY_GATE_RMS_RATIO_PERMILLE
	int "RMS threshold/noise-floor ratio (permille)"
	default 2000
	range 1000 10000

config EXAMPLES_AUDIO_EVENT_ENERGY_GATE_RMS_OFFSET
	int "RMS threshold offset"
	default 200
	range 0 32767

config EXAMPLES_AUDIO_EVENT_ENERGY_GATE_RMS_MIN
	int "Minimum RMS activity threshold"
	default 600
	range 0 32767

config EXAMPLES_AUDIO_EVENT_ENERGY_GATE_RMS_MAX
	int "Maximum RMS activity threshold"
	default 6000
	range 1 32767

config EXAMPLES_AUDIO_EVENT_ENERGY_GATE_PEAK_RATIO_PERMILLE
	int "Peak threshold/RMS threshold ratio (permille)"
	default 2500
	range 1000 20000

config EXAMPLES_AUDIO_EVENT_ENERGY_GATE_PEAK_MIN
	int "Minimum peak activity threshold"
	default 1800
	range 0 32767

config EXAMPLES_AUDIO_EVENT_ENERGY_GATE_NOISE_ALPHA_PERMILLE
	int "Quiet-block noise-floor update rate (permille)"
	default 20
	range 1 1000

config EXAMPLES_AUDIO_EVENT_ENERGY_GATE_ACTIVE_HOLD_MS
	int "Active hold after last energetic block (ms)"
	default 1500
	range 0 10000

config EXAMPLES_AUDIO_EVENT_ENERGY_GATE_FORCE_PROBE_MS
	int "Quiet forced full-inference interval (ms, 0 disables)"
	default 5000
	range 0 60000

endif # EXAMPLES_AUDIO_EVENT_POWER_ENERGY_GATE

config EXAMPLES_AUDIO_EVENT_KNOCK_THRESHOLD
	int "Knock threshold in permille"
	default 750
	range 0 1000

config EXAMPLES_AUDIO_EVENT_COUGH_THRESHOLD
	int "Cough threshold in permille"
	default 750
	range 0 1000

config EXAMPLES_AUDIO_EVENT_GLASS_THRESHOLD
	int "Glass breaking threshold in permille"
	default 750
	range 0 1000
	depends on EXAMPLES_AUDIO_EVENT_MODEL_8CLASS

config EXAMPLES_AUDIO_EVENT_KEYWORD_THRESHOLD
	int "Keyword threshold in permille"
	default 600
	range 0 1000
	depends on EXAMPLES_AUDIO_EVENT_MODEL_8CLASS
	---help---
		Threshold for keyword classes (yes/no/stop). Keywords are short
		utterances; a lower threshold than events is used so that a single
		clear utterance can trigger without requiring repeated windows.

config EXAMPLES_AUDIO_EVENT_CONSECUTIVE_HITS
	int "Consecutive windows required for an alert"
	default 2
	range 1 10

config EXAMPLES_AUDIO_EVENT_COOLDOWN_MS
	int "Alert cooldown in milliseconds"
	default 1500
	range 0 60000

config EXAMPLES_AUDIO_EVENT_OLED_UI
	bool "Enable compact 128x64 OLED status UI"
	default n
	depends on LCD_DEV
	---help---
		Enable a compact monochrome status UI for small 0.96 inch
		SSD1306-class OLED displays exposed as /dev/lcd0. This UI shows
		the current top class, confidence, RMS/volume, detection, and
		cooldown status. It is intended for ESP32-S3 DevKit style boards.

if EXAMPLES_AUDIO_EVENT_OLED_UI

config EXAMPLES_AUDIO_EVENT_OLED_DEVPATH
	string "OLED LCD device path"
	default "/dev/lcd0"

endif # EXAMPLES_AUDIO_EVENT_OLED_UI

config EXAMPLES_AUDIO_EVENT_UI
	bool "Enable LVGL dashboard UI"
	default n
	depends on GRAPHICS_LVGL
	---help---
		Enable a real-time LVGL dashboard showing audio waveform,
		classification probabilities, and detection alerts on
		LCD display.

if EXAMPLES_AUDIO_EVENT_UI

config EXAMPLES_AUDIO_EVENT_UI_DEVPATH
	string "LCD display device path"
	default "/dev/lcd0"
	---help---
		Path to the LCD display device for LVGL rendering.

endif # EXAMPLES_AUDIO_EVENT_UI

endif

config EXAMPLES_TFLM_BENCHMARK
	tristate "audio_event TFLite Micro benchmark"
	default n
	depends on TFLITEMICRO && !EXAMPLES_AUDIO_EVENT
	---help---
		Build the standalone tflm_benchmark command for the audio_event
		model. It reuses the production model data and operator resolver,
		but does not include audio capture, DSP, detection or display code.

		This option is mutually exclusive with EXAMPLES_AUDIO_EVENT because
		both applications share the same classifier implementation.

if EXAMPLES_TFLM_BENCHMARK

config EXAMPLES_TFLM_BENCHMARK_PROGNAME
	string "Program name"
	default "tflm_benchmark"

config EXAMPLES_TFLM_BENCHMARK_PRIORITY
	int "Task priority"
	default 100

config EXAMPLES_TFLM_BENCHMARK_STACKSIZE
	int "Task stack size"
	default 8192

config EXAMPLES_TFLM_BENCHMARK_BCRESNET1_8CLASS_PREFLIGHT
	bool "Use BC-ResNet1 8-class model preflight"
	default n
	---help---
		Build tflm_benchmark with the isolated BC-ResNet1 8-class model
		and its dedicated operator resolver. This does not change the
		production 4-class audio_event application.

config EXAMPLES_TFLM_BENCHMARK_S3_LARGE_8CLASS
	bool "Use S3-large 8-class model"
	default n
	depends on !EXAMPLES_TFLM_BENCHMARK_BCRESNET1_8CLASS_PREFLIGHT
	---help---
		Build tflm_benchmark with the INT8 S3-large 8-class DS-CNN model.
		The model uses the same 5880-element feature contract as the
		production model, but has four Conv2D nodes, three DepthwiseConv2D
		nodes, a 96-channel spatial Mean and eight output classes.

config EXAMPLES_TFLM_BENCHMARK_ARENA_SIZE
	int "TFLite Micro tensor arena size"
	default 196608 if EXAMPLES_TFLM_BENCHMARK_S3_LARGE_8CLASS
	default 131072 if EXAMPLES_TFLM_BENCHMARK_BCRESNET1_8CLASS_PREFLIGHT
	default 65536
	range 32768 262144

endif # EXAMPLES_TFLM_BENCHMARK
```

## app/audio_record/Kconfig
```kconfig
#
# For a description of the syntax of this configuration file,
# see the file kconfig-language.txt in the NuttX tools repository.
#

config EXAMPLES_AUDIO_RECORD
	tristate "Audio record WAV export tool"
	default n
	depends on AUDIO
	---help---
		Record a short PCM clip from an audio input device and export it as
		a base64 encoded WAV stream on the console.

if EXAMPLES_AUDIO_RECORD

config EXAMPLES_AUDIO_RECORD_PROGNAME
	string "Program name"
	default "audio_record"
	---help---
		This is the name of the program that will be used when the NSH ELF
		program is installed.

config EXAMPLES_AUDIO_RECORD_PRIORITY
	int "Audio record task priority"
	default 100

config EXAMPLES_AUDIO_RECORD_STACKSIZE
	int "Audio record task stack size"
	default 8192

config EXAMPLES_AUDIO_RECORD_DEVPATH
	string "Audio capture device path"
	default "/dev/audio/pcm_in1"

config EXAMPLES_AUDIO_RECORD_SAMPLE_RATE
	int "Audio sample rate"
	default 16000
	range 8000 48000

config EXAMPLES_AUDIO_RECORD_SECONDS
	int "Default recording duration in seconds"
	default 2
	range 1 3

config EXAMPLES_AUDIO_RECORD_MAX_SECONDS
	int "Maximum recording duration in seconds"
	default 3
	range 1 10

config EXAMPLES_AUDIO_RECORD_BLOCK_FRAMES
	int "Frames per capture read"
	default 512
	range 1 1024

config EXAMPLES_AUDIO_RECORD_INMP441_32BIT
	bool "Convert INMP441 32-bit I2S capture to mono PCM16"
	default y if ESP32S3_DEVKIT_INMP441
	default n
	---help---
		Configure the capture device as 2-channel 32-bit PCM, select one
		I2S slot, and convert it to mono int16 samples before exporting WAV.

config EXAMPLES_AUDIO_RECORD_INMP441_SLOT
	int "INMP441 slot index"
	default 0
	range 0 1
	depends on EXAMPLES_AUDIO_RECORD_INMP441_32BIT

config EXAMPLES_AUDIO_RECORD_INMP441_SHIFT
	int "INMP441 int32 to int16 right shift"
	default 16
	range 0 24
	depends on EXAMPLES_AUDIO_RECORD_INMP441_32BIT

endif
```

## app/audio_test/Kconfig
```kconfig
#
# For a description of the syntax of this configuration file,
# see the file kconfig-language.txt in the NuttX tools repository.
#

config EXAMPLES_AUDIO_TEST
	tristate "Audio capture diagnostic tool"
	default n
	depends on AUDIO
	---help---
		Lightweight PCM capture diagnostic command. It opens an audio input
		device, captures PCM, and prints amplitude stats.

if EXAMPLES_AUDIO_TEST

config EXAMPLES_AUDIO_TEST_PROGNAME
	string "Program name"
	default "audio_test"
	---help---
		This is the name of the program that will be used when the NSH ELF
		program is installed.

config EXAMPLES_AUDIO_TEST_PRIORITY
	int "Audio test task priority"
	default 100

config EXAMPLES_AUDIO_TEST_STACKSIZE
	int "Audio test stack size"
	default 8192

config EXAMPLES_AUDIO_TEST_DEVPATH
	string "Audio capture device path"
	default "/dev/audio/pcm_in1"

config EXAMPLES_AUDIO_TEST_SAMPLE_RATE
	int "Audio sample rate"
	default 16000
	range 8000 48000

config EXAMPLES_AUDIO_TEST_CHANNELS
	int "Audio channel count"
	default 1
	range 1 2

config EXAMPLES_AUDIO_TEST_INMP441_32BIT
	bool "Decode INMP441 32-bit I2S capture"
	default y if ESP32S3_DEVKIT_INMP441
	---help---
		Configure the device as 2-channel 32-bit PCM and decode the selected
		INMP441 slot to mono int16. The diagnostic output also prints both
		decoded slots so slot alignment and gain/shift issues are visible.

config EXAMPLES_AUDIO_TEST_INMP441_SLOT
	int "INMP441 slot index"
	default 0
	range 0 1
	depends on EXAMPLES_AUDIO_TEST_INMP441_32BIT

config EXAMPLES_AUDIO_TEST_INMP441_SHIFT
	int "INMP441 int32 to int16 right shift"
	default 16
	range 0 24
	depends on EXAMPLES_AUDIO_TEST_INMP441_32BIT

config EXAMPLES_AUDIO_TEST_BLOCK_FRAMES
	int "Frames per capture read"
	default 512
	range 1 1024

endif
```
